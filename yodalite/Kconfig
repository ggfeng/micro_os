## yodalite/Kconfig
```kconfig
#
# For a description of the syntax of this configuration file,
# see kconfig/kconfig-language.txt.
#
mainmenu "YODALITE AIoT Development Framework Configuration"

menu "SDK MCU Configuration"

choice
    prompt "Architecture Select"
    default LX6

    config ARM
    bool "ARM"

    config LX6
    bool "LX6"

endchoice

choice
    prompt "CPU Select"
    default ESP32

    config STM32F407ZG
    bool "STM32F407ZG"
    select ARM_CM4F
    depends on ARM

    config STM32F411CEYx
    bool "STM32F411CEYx"
    depends on ARM
	
    config STM32F072CBY
    bool "STM32F072CBY"
    depends on ARM

    config XR871GT
    bool "XR871GT"
    depends on ARM

    config XR872AT
    bool "XR872AT"
    depends on ARM

    config ESP32
    bool "ESP32"
    depends on LX6
endchoice

choice 
   prompt "BOARD Select"
   default ESP32_LyraT

   config ESP32_LyraT
   bool "ESP32_LyraT"
   depends on ESP32

   config KENOBI
   bool "KENOBI"
   depends on STM32F072CBY

   config LUKE
   bool "LUKE"
   depends on STM32F411CEYx

   config DISCOVERY
   bool "DISCOVERY"
   depends on STM32F407ZG

   config XR871
   bool "XR871"
   depends on XR871GT

   config XR872
   bool "XR872"
   depends on XR872AT
endchoice
    
endmenu 

menu "SDK Build Format"

choice SDK_BUILD_FORMAT
    prompt "SDK Build Format"
    default SDK_BUILD_LIBA 
    help
      SDK build as static lib or execute file 

    config SDK_BUILD_LIBA   
 	    bool "liba"
    config SDK_BUILD_EXE
            bool "exe"
endchoice

endmenu

menu "SDK General Character"

config PLATFORM_UART_INTERFACE 
     bool "platform uart interface"
     default n
     help
       platform uart interface 

config REALLOC_NO_SUPPORT 
     bool "REALLOC NOT support"
     default n 
     help
       realloc not support 


config SPRINF_NO_FLOAT_SUPPORT 
     bool "sprintf no float support"
     default n
     help
       sprinf no float 


endmenu

menu "SDK Tool Configuration"

config TOOLPREFIX
    string "Compiler toolchain path/prefix"
    default "arm-none-eabi-"
    help
        The prefix/path that is used to call the toolchain. The default setting assumes
        a crosstool-ng gcc setup that is in your PATH.

config MAKE_WARN_UNDEFINED_VARIABLES
    bool "'make' warns on undefined variables"
    default "y"
    help
        Adds --warn-undefined-variables to MAKEFLAGS. This causes make to
        print a warning any time an undefined variable is referenced.

        This option helps find places where a variable reference is misspelled
        or otherwise missing, but it can be unwanted if you have Makefiles which
        depend on undefined variables expanding to an empty string.

endmenu  # SDK tool configuration

menu "Compiler options"

choice OPTIMIZATION_COMPILER
     bool  "Optimization Level"
    default OPTIMIZATION_LEVEL_DEBUG
    help
        This option sets compiler optimization level (gcc -O argument).

        - for "Release" setting, -Os flag is added to CFLAGS.
        - for "Debug" setting, -Og flag is added to CFLAGS.

        "Release" with -Os produces smaller & faster compiled code but it
        may be harder to correlated code addresses to source files when debugging.

        To add custom optimization settings, set CFLAGS and/or CPPFLAGS
        in project makefile, before including $(IDF_PATH)/make/project.mk. Note that
        custom optimization levels may be unsupported.

	config OPTIMIZATION_LEVEL_DEBUG
    	    bool "Debug (-Og)"
        config OPTIMIZATION_LEVEL_RELEASE
            bool "Release (-Os)"
endchoice

choice OPTIMIZATION_ASSERTION_LEVEL
    prompt "Assertion level"
    default OPTIMIZATION_ASSERTIONS_ENABLED
    help
        Assertions can be:

        - Enabled. Failure will print verbose assertion details. This is the default.

        - Set to "silent" to save code size (failed assertions will abort() but user
          needs to use the aborting address to find the line number with the failed assertion.)

        - Disabled entirely (not recommended for most configurations.) -DNDEBUG is added
          to CPPFLAGS in this case.

config OPTIMIZATION_ASSERTIONS_ENABLED
    prompt "Enabled"
    bool
    help
        Enable assertions. Assertion content and line number will be printed on failure.

config OPTIMIZATION_ASSERTIONS_SILENT
    prompt "Silent (saves code size)"
    bool
    help
        Enable silent assertions. Failed assertions will abort(), user needs to
        use the aborting address to find the line number with the failed assertion.

config OPTIMIZATION_ASSERTIONS_DISABLED
    prompt "Disabled (sets -DNDEBUG)"
    bool
    help
        If assertions are disabled, -DNDEBUG is added to CPPFLAGS.

endchoice # assertions
endmenu

menu "SDK Component Configuration"

config AIAL_ENABLE
    bool "Enable AIAL"
    default n
    help
       Enable AIAL

if AIAL_ENABLE
 source "aial/Kconfig"
endif


config APP_ENABLE
     bool "Enable APP"
     default n
     help 
        Enable APP

if APP_ENABLE
 source "app/Kconfig"
endif

config HAPI_ENABLE
     bool "Enable Application High API"
     default n
     help
        Enable Application High API

if HAPI_ENABLE
 source "hapi/Kconfig"
endif

config HARDWARE_ENABLE
     bool "Enable Hardware"
     default n
     help 
       Enable Hardware

if HARDWARE_ENABLE
 source "hardware/Kconfig"
endif

config LIBS_ENABLE
     bool "Enable Tree parts Library"
     default y
     help 
       Enable Tree parts Library

if LIBS_ENABLE
 source "lib/Kconfig"
endif

config OSAL_ENABLE
     bool "OS Hal Layer"
     default n
     help 
       OS Hal Layer

if OSAL_ENABLE
 source "osal/Kconfig"
endif

config PRODUCTS_ENABLE
     bool "PRODUCTS ENABLE"
     default n
     help 
       PRODUCTS ENABLE

if PRODUCTS_ENABLE
 source "products/Kconfig"
endif
endmenu	
```

## yodalite/build_dir/arm-none-eabi-dir/app/Kconfig
```kconfig
menu "APP Configure"

config FTM_ENABLE

     bool "FTM ENABLE"
     depends on APP_ENABLE 
     depends on FACTORY_ENABLE 
     default n
     help
         FTM ENABLE

config OTA_ENABLE

     bool "OTA ENABLE"
     depends on APP_ENABLE
     default n
     help
         OTA ENABLE

config FLORA_TEST_ENABLE

     bool "FLORA_TEST ENABLE"
     depends on SHELL_ENABLE
     depends on FLORA_LITE_ENABLE
     depends on APP_ENABLE
     default n
     help
         FLORA_TEST ENABLE

config NETMGR_TEST_ENABLE

     bool "NETMGR_TEST ENABLE"
     depends on SHELL_ENABLE
     depends on APP_ENABLE
     depends on NETMGR_LITE_ENABLE
     default n
     help
         NETMGR_TEST ENABLE

config ELOOP_TEST_ENABLE

     bool "ELOOP_TEST ENABLE"
     depends on SHELL_ENABLE
     depends on APP_ENABLE
     depends on ELOOP_ENABLE
     default n
     help
         ELOOP_TEST ENABLE

config FATFS_TEST_ENABLE
     bool "FATFS_TEST ENABLE"
     depends on SHELL_ENABLE
     depends on APP_ENABLE
     depends on FATFS_ENABLE
     default n
     help
         FATFS_TEST ENABLE

config CJSON_TEST_ENABLE
     bool "CJSON_TEST ENABLE"
     depends on SHELL_ENABLE
     depends on APP_ENABLE
     depends on CJSON_ENABLE
     default n
     help
         CJSON_TEST ENABLE

config LIB_TEST_ENABLE
     bool "LIB_TEST ENABLE"
     depends on SHELL_ENABLE
     depends on APP_ENABLE
     depends on LIBTEST_ENABLE
     default n
     help
         LIB_TEST ENABLE

config NETTOOL_TEST_ENABLE
     bool "NET_TEST ENABLE"
     depends on SHELL_ENABLE
     depends on APP_ENABLE
     depends on NETTOOL_ENABLE
     default n
     help
         NETTOOL_TEST ENABLE

config PROPERTY_TEST_ENABLE
     bool "PROPERTY_TEST ENABLE"
     depends on SHELL_ENABLE
     depends on APP_ENABLE
     depends on PROPERTY_ENABLE
     default n
     help
         PROPERTY_TEST ENABLE

config WIFI_TEST_ENABLE
     bool "WIFI_TEST ENABLE"
     depends on SHELL_ENABLE
     depends on APP_ENABLE
     depends on WIFI_HAL_ENABLE
     default n
     help
         WIFI_TEST ENABLE

config INPUT_TEST_ENABLE
     bool "INPUT_TEST ENABLE"
     depends on SHELL_ENABLE
     depends on PAL_INPUT_ENABLE
     depends on APP_ENABLE
     default n
     help
         INPUT_TEST ENABLE

config AES_TEST_ENABLE
     bool "AES_TEST ENABLE"
     depends on SHELL_ENABLE
     depends on LIBAES_ENABLE
     depends on APP_ENABLE
     default n
     help
         AES_TEST ENABLE

config MD5_TEST_ENABLE
     bool "MD5_TEST ENABLE"
     depends on SHELL_ENABLE
     depends on LIBMD5_ENABLE
     depends on APP_ENABLE
     default n
     help
         Md5_TEST ENABLE

config BASE64_TEST_ENABLE
     bool "BASE64_TEST ENABLE"
     depends on SHELL_ENABLE
     depends on LIBBASE64_ENABLE
     depends on APP_ENABLE
     default n
     help
         Base64_TEST ENABLE

config AUTH_TEST_ENABLE
     bool "AUTH_TEST ENABLE"
     depends on SHELL_ENABLE
     depends on AUTH_ENABLE
     depends on APP_ENABLE
     default n
     help
         AUTH_TEST ENABLE

config MEMEXT_TEST_ENABLE
     bool "MEMEXT TEST ENABLE"
     depends on MEM_EXT_ENABLE
     default n
     help
         MEM_EXT_TEST ENABLE

config BT_TEST_ENABLE
     bool "BT_TEST ENABLE"
     depends on SHELL_ENABLE
	 depends on BLUETOOTH_HAL_ENABLE
     depends on APP_ENABLE
     default n
     help
         BT_TEST ENABLE

config BTMGR_TEST_ENABLE

     bool "BTMGR_TEST ENABLE"
     depends on SHELL_ENABLE
     depends on APP_ENABLE
     depends on BLUETOOTHMGR_ENABLE 
     default n
     help
         BTMGR_TEST ENABLE

config ASOUND_TEST_ENABLE
     bool "ASOUND TEST ENABLE"
     depends on SHELL_ENABLE
     depends on APP_ENABLE
     default n
     help 
        ASOUND_TEST_ENABLE

config MQTT_TEST_ENABLE
     bool "MQTT TEST ENABLE"
     depends on LWIP_ENABLE
     default n
     help 
        MQTT_TEST_ENABLE

config SOCKET_TEST_ENABLE
     bool "SOCKET TEST ENABLE"
     default n
     help 
        SOCKET_TEST_ENABLE

config APPMGR_TEST_ENABLE
     bool "APPMGR TEST ENABLE"
     depends on SHELL_ENABLE
     depends on APP_ENABLE
     depends on APPMGR_ENABLE
     default n
     help
         APPMGR_TEST_ENABLE

config PRTTN_INFO_SHOW_ENABLE
     bool "PRTTN INFO SHOW ENABLE "
     depends on SHELL_ENABLE
     depends on APP_ENABLE
     default n
     help
         PRTTN INFO SHOW ENABLE 

config ANDLINK_TEST_ENABLE
     bool "ANDLINK TEST ENABLE"
     depends on SHELL_ENABLE
     depends on APP_ENABLE
     depends on ANDLINK_ENABLE
	 default n
	 help  
	   ANDLINK TEST ENABLE

config BLINK_TEST_ENABLE
     bool "BLINK TEST ENABLE "
     depends on SHELL_ENABLE
     depends on APP_ENABLE
     default n
     help
         BLINK TEST ENABLE 

config POSIX_TEST_ENABLE     
     bool "POSIX TEST ENABLE"
     depends on SHELL_ENABLE
     depends on APP_ENABLE
     default n
     help
         POSIX TEST ENABLE

config PTHREAD_TEST_ENABLE     
     bool "PTHREAD TEST ENABLE"
     depends on SHELL_ENABLE
     depends on APP_ENABLE
     depends on POSIX_TEST_ENABLE
     default n
     help
         PTHREAD TEST ENABLE

config COND_TEST_ENABLE     
     bool "COND TEST ENABLE"
     depends on SHELL_ENABLE
     depends on APP_ENABLE
     depends on POSIX_TEST_ENABLE
     default n
     help
         COND TEST ENABLE

config TASK_TEST_ENABLE     
     bool "TASK TEST ENABLE"
     depends on SHELL_ENABLE
     depends on APP_ENABLE
     default n
     help
         TASK TEST ENABLE

config MQ_TEST_ENABLE     
     bool "MQ TEST ENABLE"
     depends on SHELL_ENABLE
     depends on APP_ENABLE
     depends on POSIX_TEST_ENABLE
     default n
     help
         MQ TEST ENABLE

endmenu
```

## yodalite/build_dir/arm-none-eabi-dir/hardware/modules/Kconfig
```kconfig
menu "MODULES Configure"

config MODULES_LEDS_ENABLE

    bool "MODULES_LEDS ENABLE"
    depends on MODULES_ENABLE
    default n
    help
        MODULES_LEDS ENABLE

config BOARD_LED_NUMS

    int "led nums used"
    depends on MODULES_LEDS_ENABLE
    default 1
    help
        BOARD_LED NUMS

config MODULES_MICARRAY_ENABLE

    bool "MODULES_MICARRAY ENABLE"
    depends on MODULES_ENABLE
    default n
    help
        MODULES_MICARRAY ENABLE

config BOARD_MIC_CHANNEL

    int "MIC nums used"
    depends on MODULES_MICARRAY_ENABLE
    default 2
    help
        BOARD_MIC CHANNEL

config BOARD_SOUND_CARDID

    int "sound card id"
    depends on MODULES_MICARRAY_ENABLE
    default 0
    help
        BOARD_SOUND CARDID

config BOARD_CAPTURE_DEVICEID

    int "capture device id"
    depends on MODULES_MICARRAY_ENABLE
    default 3
    help
        BOARD_CAPTURE DEVICEID

config MIC_SAMPLE_RATE

    int "mic sample rate"
    depends on MODULES_MICARRAY_ENABLE
    default 48000
    help
        MIC_SAMPLE RATE

config WIFI_HAL_ENABLE
	bool "WIFI_HAL_ENABLE"
	depends on MODULES_ENABLE
	default n
	help
	  WIFI_HAL_ENABLE

config WIFI_SMART_SNIFFER_ENABLE
	bool "WIFI_SMART_SNIFFER_ENABLE"
	depends on WIFI_HAL_ENABLE
	default n
	help
	  WIFI_SMART_SNIFFER_ENABLE

config BLUETOOTH_HAL_ENABLE
	bool "BLUETOOTH_HAL_ENABLE"
	depends on MODULES_ENABLE
	default n
	help
	  BLUETOOTH_HAL_ENABLE

endmenu
```

## yodalite/build_dir/arm-none-eabi-dir/hardware/pal/Kconfig
```kconfig
menu "PAL Configure"

config PAL_GPIO_ENABLE

    bool "PAL_GPIO ENABLE"
    depends on PAL_ENABLE
    default n
    help
        PAL_GPIO ENABLE

config PAL_I2C_ENABLE

    bool "PAL_I2C ENABLE"
    depends on PAL_ENABLE
    default n
    help
        PAL_I2C ENABLE

config PAL_USB_ENABLE

    bool "PAL_USB ENABLE"
    depends on PAL_ENABLE
    default n
    help
        PAL_USB ENABLE

config PAL_ASOUND_ENABLE

    bool "PAL_ASOUND ENABLE"
    depends on PAL_ENABLE
    default n
    help
        PAL_ASOUND ENABLE

config PAL_IRQ_ENABLE

    bool "PAL_IRQ ENABLE"
    depends on PAL_ENABLE
    default n
    help
        PAL_IRQ ENABLE

config PAL_AUTH_ENABLE

    bool "PAL_AUTH ENABLE"
    depends on PAL_ENABLE
    default n
    help
        PAL_AUTH ENABLE

config PAL_SPI_ENABLE

    bool "PAL_SPI ENABLE"
    depends on PAL_ENABLE
    default n
    help
        PAL_SPI ENABLE

config PAL_UART_ENABLE

    bool "PAL_UART ENABLE"
    depends on PAL_ENABLE
    default n
    help
        PAL_UART ENABLE

config PAL_INPUT_ENABLE

    bool "PAL_INPUT ENABLE"
    depends on PAL_ENABLE
    depends on FLORA_LITE_ENABLE
    default n
    help
        PAL_INPUT ENABLE

config PAL_FLASH_ENABLE
    bool "PAL_FLASH ENABLE"
    depends on PAL_ENABLE
    default n
    help
        PAL_FLASH ENABLE
endmenu
```

## yodalite/build_dir/arm-none-eabi-dir/lib/FreeRTOS/Kconfig
```kconfig
menu "FREERTSO HARDWARE Configure"

config ARM_CM4F

     bool "ARM_CM4F"
     depends on FREERTOS_ENABLE
     default n
     help
       ARM_CM4F HARDWARE SUPPORT  

endmenu
```
