## yodalite/build_dir/arm-none-eabi-dir/lib/Kconfig
```kconfig
menu "LIBS Configure"

config LIBC_ENABLE

     bool "Enable C Library"
     depends on LIBS_ENABLE
     default n
     help
        c library

if LIBC_ENABLE
source  "lib/libc/Kconfig"
endif

config LIBTEST_ENABLE

     bool "Enable lib test"
     depends on LIBS_ENABLE
     default y  if LIBS_ENABLE
     help
       enable libtest  

config FREERTOS_ENABLE

     bool "Enable FREERTOS"
     depends on LIBS_ENABLE
     default n  
     help
       enable freertos  

if FREERTOS_ENABLE
source  "lib/FreeRTOS/Kconfig"
endif

config LIST_ENABLE

     bool "Enable List"
     depends on LIBS_ENABLE
     default n 
     help
       enable List

config SHELL_ENABLE

     bool "Enable Shell"
     depends on LIBS_ENABLE
     select LIST_ENABLE

     select YODALITE_PRINTF_ENABLE if LIBC_ENABLE

     help
       enable shell 

config CJSON_ENABLE

     bool "Enable CJSON"
     depends on LIBS_ENABLE
     default n
     select YODALITE_STRING_ENABLE if LIBC_ENABLE

     help
       enable cjson

config BM_ENABLE

     bool "Enable Buffer Manager"
     depends on LIBS_ENABLE
     default n
     help
       enable bm

config FATFS_ENABLE

     bool "Enable FATFS"
     depends on LIBS_ENABLE
     default n
     select YODALITE_STRING_ENABLE if LIBC_ENABLE

     help
       enable fatfs 

if FATFS_ENABLE
source  "lib/fatfs/Kconfig"
endif

config LWIP_ENABLE

     bool "Enable LWIP"
     depends on LIBS_ENABLE
     default n
     help
       enable lwip 

config NETTOOL_ENABLE

     bool "Enable nettool"
#    depends on LWIP_ENABLE
     default n
     help
       enable nettool 

if NETTOOL_ENABLE
source  "lib/nettool/Kconfig"
endif


config ELOOP_ENABLE

     bool "Enable eloop"
     depends on OSAL_ENABLE
     default n
     help
       enable eloop

config PROPERTY_ENABLE

     bool "Enable property"
     select FATFS_ENABLE
     default n
     help
       enable property 

config LIBAES_ENABLE

     bool "Enable libaes"
     depends on LIBS_ENABLE
     default n
     help
       enable libaes 

config LIBMD5_ENABLE

     bool "Enable libmd5"
     depends on LIBS_ENABLE
     default n
     help
       enable libmd5 

config LIBBASE64_ENABLE

     bool "Enable lib base64"
     depends on LIBS_ENABLE
     default n
     help
       enable lib base64 

config LIBRSA_ENABLE

     bool "Enable lib rsa"
     depends on LIBS_ENABLE
     default n
     help
       enable lib rsa 

config MEM_EXT_ENABLE
     bool "Enable lib mem_ext"
     depends on LIBS_ENABLE
     default n
     help
       enable mem ext

if MEM_EXT_ENABLE
source  "lib/mem_ext/Kconfig"
endif
endmenu
```

## yodalite/build_dir/arm-none-eabi-dir/lib/fatfs/Kconfig
```kconfig
config FATFS_SECTOR_SIZE
     int "fatfs sector size"
     range 512  4096
     default 4096 
     depends on FATFS_ENABLE
     help 
       fatfs sector size:512 1024 2048 4096 

config FATFS_FLASH_BASE
     hex "fatfs flash base"
     default 0x140000
     depends on FATFS_ENABLE
     help 
       fatfs flash base

config FATFS_FLASH_SIZE
     hex "fatfs flash size"
     range 0x10000  0x200000
     default 0xc0000 
     depends on FATFS_ENABLE
     help 
       fatfs flash size
```

## yodalite/build_dir/arm-none-eabi-dir/lib/nettool/Kconfig
```kconfig
config SNTP_TIMER 
     bool "Enable sntp timer"
     depends on NETTOOL_ENABLE
     default n
     help
       enable sntp timer 

config OPT_RCVTIMEO_INT
     bool "Enable opt recv timeo int"
     depends on NETTOOL_ENABLE
     default n
     help
       enable nettool 
```

## yodalite/hapi/Kconfig
```kconfig
menu "HAPI Configure"


config AUDIO_OUT_ENABLE

     bool "AUDIO OUT ENABLE"
     depends on HAPI_ENABLE
     default n
     help
         AUDIO OUT ENABLE

config BATTERYMGR_ENABLE

     bool "BATTERYMGR  ENABLE"
     depends on HAPI_ENABLE 
     default n 
     help
         AUTHMGR ENABLE


config BLUETOOTHMGR_ENABLE 

     bool "BLUETOOTHMGR ENABLE"
     depends on HAPI_ENABLE 
     default n 
     help
         BLUETOOTHMGR ENABLE

config DISPLAY_ENABLE 

     bool "DISPLAY ENABLE"
     depends on HAPI_ENABLE 
     default n 
     help
         DISPLAY ENABLE

config INPUT_ENABLE 

     bool "INPUT ENABLE"
     depends on HAPI_ENABLE 
     default n 
     help
         INPUT ENABLE

config LUMEN_LIGHT_ENABLE

     bool "LUMEN ENABLE"
     depends on HAPI_ENABLE 
     default n 
     help
         LUMEN ENABLE

config PIPE_LINE_ENABLE

     bool "PIPE LINE ENABLE"
     depends on HAPI_ENABLE 
     default n 
     help
         PIPE LINE ENABLE

config POWERMGR_ENABLE

     bool "POWERMGR ENABLE"
     depends on HAPI_ENABLE 
     default n 
     help
         POWERMGR ENABLE

config RECOVERY_ENABLE

     bool "RECOVERY ENABLE"
     depends on HAPI_ENABLE 
     default n 
     help
         RECOVERY ENABLE

config SENSORMGR_ENABLE

     bool "SENSORMGR ENABLE"
     depends on HAPI_ENABLE 
     default n 
     help
         SENSORMGR ENABLE

config VIDEO_IN_ENABLE

     bool "VIDEO IN ENABLE"
     depends on HAPI_ENABLE 
     default n 
     help
         VIDEO IN ENABLE

config FLORA_LITE_ENABLE

     bool "FLORA_LITE ENABLE"
     depends on HAPI_ENABLE
     default n
     help
         FLORA_LITE ENABLE

config NETMGR_LITE_ENABLE

     bool "NETMGR LITE ENABLE"
     select FLORA_LITE_ENABLE
     select ELOOP_ENABLE
     select PROPERTY_ENABLE

     depends on HAPI_ENABLE
     default n
     help
         NETMGR ENABLE

config ACTIVATION_ENABLE

     bool "ACTIVATION ENABLE"
     select FLORA_LITE_ENABLE
     select ELOOP_ENABLE
     select PROPERTY_ENABLE

     depends on HAPI_ENABLE
     default n
     help
         ACTIVATION ENABLE

config ANDLINK_ENABLE
     bool "ANDLINK ENABLE"

     help
         ANDLINK ENABLE

config APPMGR_ENABLE

     bool "APPMGR ENABLE"
     select FLORA_LITE_ENABLE
     depends on HAPI_ENABLE
     default n
     help
         APPMGR ENABLE

config AUTH_ENABLE

     bool "AUTH ENABLE"
     depends on HAPI_ENABLE 
	 depends on LIBAES_ENABLE
	 depends on LIBRSA_ENABLE
	 depends on LIBBASE64_ENABLE
     default n
     help
         Auth check

config FACTORY_ENABLE 
     bool "FACTORY ENABLE"
     depends on PAL_FLASH_ENABLE
     default n
     help
         factory enable 
config ASOUND_ENABLE
     bool "ASOUND_ENABLE"
     depends on HAPI_ENABLE
     default n
     help 
        ASOUND ENABLE

config RECORD_KWS_ENABLE
     bool "RECORD_KWS_ENABLE"
     depends on HAPI_ENABLE
     default n
     help 
       record_kws ENABLE

config SMART_CONFIG_ENABLE
     bool "Enable smart config"
     depends on HAPI_ENABLE
     default n
     help
       enable smart config


if FACTORY_ENABLE
source  "hapi/factory/Kconfig"
endif
endmenu
```

## yodalite/hapi/factory/Kconfig
```kconfig
config KEY_PART_FLASH_NAME
    string  "key parttion location"
    depends on PAL_FLASH_ENABLE
    default "spiflash/0"
    help
       key parttion location

config KEY_PART_ADDR
     hex "key partition base addr"
     depends on PAL_FLASH_ENABLE
     default 0xe000 
     help 
       key partition base addr

config KEY_PART_SIZE
     hex "key partition size"
     range 0x100  0x10000
     default 0x1000 
     depends on PAL_FLASH_ENABLE
     help 
       key partition size 
```

## yodalite/hardware/Kconfig
```kconfig
menu "HARDWARE Configure"

config LIB_HARDWARE_ENABLE

     bool "Enable lib hardware"
     depends on HARDWARE_ENABLE
     default n 
     help
      Enable lib hardware

config MODULES_ENABLE

     bool "MODULES ENABLE"
     depends on HARDWARE_ENABLE 
     default n 
     help
         MODULES ENABLE

if MODULES_ENABLE
source "hardware/modules/Kconfig"
endif

config PAL_ENABLE

     bool "PAL ENABLE"
     depends on HARDWARE_ENABLE 
     default n 
     help
         PAL ENABLE

if PAL_ENABLE
source "hardware/pal/Kconfig"
endif

config DRIVER_ENABLE

     bool "DRIVER ENABLE"
     depends on HARDWARE_ENABLE
     default n
     help
         DRIVER ENABLE

if DRIVER_ENABLE
source "hardware/driver/Kconfig"
endif

endmenu
```

## yodalite/hardware/driver/Kconfig
```kconfig
menu "Driver Configure"

config DRIVER_BASE_ENABLE

    bool "DRIVER_BASE ENABLE"
    depends on DRIVER_ENABLE
    default n
    help
        DRIVER_BASE ENABLE

config DRIVER_USBHUB_ENABLE
    bool "DRIVER_USBHUB ENABLE"
    depends on DRIVER_ENABLE
    default n
    help
	DRIVER_USBHUB ENABLE

config DRIVER_ISL97900_ENABLE
    bool "DRIVER_ISL97900 ENABLE"
    depends on DRIVER_ENABLE
    default n
    help
	DRIVER_ISL97900 ENABLE

config DRIVER_LIGHTSENSOR_ENABLE
    bool "DRIVER_LIGHTSENSOR ENABLE"
    default n
    help
	DRIVER_LIGHTSENSOR ENABLE

config DRIVER_OP2220_ENABLE
    bool "DRIVER_OP2220 ENABLE"
    default n
    help
	DRIVER_OP2220 ENABLE

config DRIVER_TOUCH_ENABLE
    bool "DRIVER_TOUCH ENABLE"
    default n
    help
        DRIVER_TOUCH ENABLE

config DRIVER_IMU_ENABLE
    bool "DRIVER_IMU ENABLE"
    default n
    help
        DRIVER_IMU ENABLE

config DRIVER_PSENSOR_ENABLE
    bool "DRIVER_PSENSOR ENABLE"
    default n
    help
        DRIVER_PSENSOR ENABLE


endmenu
```

## yodalite/lib/libc/Kconfig
```kconfig
config YODALITE_MALLOC_ENABLE
     bool "Enable Yodalite Malloc"
     depends on LIBC_ENABLE
     default n 
     help 
       Enable Yodalite Malloc

config MALLOC_SPLIT_THRESH
     int "Malloc Split Threshold"
     range 4 64
     default 8
     depends on YODALITE_MALLOC_ENABLE
     help 
       Malloc Split Threshold

config MALLOC_ALIGN_BYTES
     int  "Malloc Align Bytes"
     range 4 64
     default 8
     depends on YODALITE_MALLOC_ENABLE
     help 
       Malloc Align Bytes

config MALLOC_BLOCK_COUNTS
     int "Malloc Block Counts"
     range 16 256
     default 64
     depends on YODALITE_MALLOC_ENABLE
     help 
       Malloc Block Counts

if YODALITE_MALLOC_ENABLE

choice
    prompt "MALLOC POOL SOURCE"
    default ABSOLUT

    config ABSOLUT
    bool "ABSOLUT"

    config GLOBAL
    bool "GLOBAL"

endchoice

endif

config MALLOC_POOL_BASE
     hex "Malloc Pool Base"
     depends on YODALITE_MALLOC_ENABLE && ABSOLUT
     default 0x10000000 
     help 
       Malloc Pool Base

config MALLOC_POOL_SIZE
     hex "Malloc Pool Size"
     range 0x100  0x10000000
     default 0x400 
     depends on YODALITE_MALLOC_ENABLE
     help 
       Malloc Pool Size

config YODALITE_PRINTF_ENABLE
     bool "Enable Yodalite Printf"
     depends on LIBC_ENABLE
     default n 
     help 
       Enable Yodalite Printf

config YODALITE_STRING_ENABLE
     bool "Enable Yodalite String"
     depends on LIBC_ENABLE
     default n
     help 
       Enable Yodalite String 
```

## yodalite/lib/mem_ext/Kconfig
```kconfig
config MEM_EXT_DEBUG

     bool "Enable mem_ext debug"
     depends on MEM_EXT_ENABLE
     default n
     help
       enable mem_ext debug
```

## yodalite/osal/Kconfig
```kconfig
menu "FREERTOS HAL Configure"

config FREERTOS_HAL
     bool "FREERTOS_HAL"
     depends on OSAL_ENABLE
     default n 
     help
       freertos hal  

config SUPPORT_STATIC_ALLOCATION
     bool "freertos support static allocation"
     default y 
     help
       freertos support static allocation 

config RTOS_VERSION_LOWER_THAN_8_2_3
     bool "freertos version lower than 8.2.3"
     default n
     help
       freertos version lower than 8.2.3 


config OSAL_PTHREAD
     bool "osal pthread"
     default n
     help
       osal pthread 


config OSAL_PTHREAD_STACK_SIZE 
     hex "osal pthread stack size"
     depends on OSAL_PTHREAD
     default 0x800 
     help 
       osal pthread stack size

config OSAL_PTHREAD_WITH_DIFF_NAME
     bool "osal pthread with different name"
     depends on OSAL_PTHREAD
     default n
     help
	   osal pthread with different name


config OSAL_PTHREAD_MUTEX
     bool "osal pthread mutex"
	 default n
	 help
	    osal pthread mutex

config OSAL_PTHREAD_BARRIER
	bool "osal pthread barrier"
	default n
	help
		osal pthread barrier

config OSAL_PTHREAD_COND
    bool "osal pthread cond"
	depends on OSAL_PTHREAD_MUTEX
	default n
	help 
	   osal pthread cond

config OSAL_CLOCK
     bool "osal clock"
     default n
     help
       osal clock 

config OSAL_UNISTD
     bool "osal unistd"
     default n
     help
       osal unistd 

config OSAL_MQ
     bool "osal mq"
     default n
     help
       osal mq 

config OSAL_MQ_PTHREAD
     bool "osal mq pthread"
     depends on OSAL_MQ
     default n
     help
       osal mq pthread

config OSAL_SEMAPHORE
     bool "osal semaphore"
	 default n
	 help
	   osal semaphore

config OSAL_TIMER
     bool "osal timer"
	 default n
	 help 
	    osal timer

config OSAL_SCHED
	bool "osal sched"
	default n
	help
	  osal sched


endmenu
```

## yodalite/products/Kconfig
```kconfig
menu "PRODUCTS Configure"

config ROKID_PRODUCTS 

     bool "ROKID PRODUCTS"
     depends on PRODUCTS_ENABLE
     default n 
     help
       ROKID PRODUCTS  

endmenu
```

## yodalite/products/rokid/esp32/ailib/Kconfig
```kconfig
menu "ROKID_ASR_LIBRARY"

config ROKID_ASR_ENABLE
bool "Enable Rokid ASR"
default "y"

endmenu
```

## yodalite/products/rokid/esp32/components/ext_mem_api/Kconfig
```kconfig
menu "Yodalite Externel Memory Hardware"

config EXTERNEL_MEMORY_HARDWARE_ENABLE
bool "Enable externle fatfs Hardware"
default "y"

endmenu
```

## yodalite/products/rokid/esp32/components/fatfs_api/Kconfig
```kconfig
menu "Yodalite Fatfs Hardware"

config FATFS_HARDWARE_ENABLE
bool "Enable Fatfs Hardware"
default "y"

endmenu
```

## yodalite/products/rokid/esp32/components/flash_api/Kconfig
```kconfig
menu "Yodalite flash Hardware"

config FLASH_HARDWARE_ENABLE
bool "Enable flash Hardware"
default "y"

endmenu
```

## yodalite/products/rokid/esp32/components/rokid_sdk/Kconfig
```kconfig
menu "ROKID_SDK_LIBRARY"

config ROKID_SDK_ENABLE
bool "Enable Rokid Sdk"
default "y"

endmenu
```

## yodalite/products/rokid/esp32/components/wifi_api/Kconfig
```kconfig
menu "WIFI_API_ENABLE"

config WIFI_API_ENABLE
bool "Enable wifi api"
default "y"

endmenu
```
